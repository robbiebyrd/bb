VERSION ""

NS_ :

BS_:

BU_:

BO_ 2024 OBD2_Mode01: 8 Vector__XXX
 SG_ S01PID M : 23|8@0+ (1,0) [0|255] "" Vector__XXX
 SG_ S01PID00_PIDsSupported_01_20 m0 : 31|32@0+ (1,0) [0|4294967295] "" Vector__XXX
 SG_ S01PID01_MonitorStatus m1 : 31|32@0+ (1,0) [0|4294967295] "" Vector__XXX
 SG_ S01PID02_FreezeDTC m2 : 31|16@0+ (1,0) [0|65535] "" Vector__XXX
 SG_ S01PID03_FuelSystemStatus m3 : 31|16@0+ (1,0) [0|65535] "" Vector__XXX
 SG_ S01PID04_CalcEngineLoad m4 : 31|8@0+ (0.39216,0) [0|100] "%" Vector__XXX
 SG_ S01PID05_EngineCoolantTemp m5 : 31|8@0+ (1,-40) [-40|215] "degC" Vector__XXX
 SG_ S01PID06_ShortFuelTrimBank1 m6 : 31|8@0+ (0.78125,-100) [-100|99.21875] "%" Vector__XXX
 SG_ S01PID07_LongFuelTrimBank1 m7 : 31|8@0+ (0.78125,-100) [-100|99.21875] "%" Vector__XXX
 SG_ S01PID08_ShortFuelTrimBank2 m8 : 31|8@0+ (0.78125,-100) [-100|99.21875] "%" Vector__XXX
 SG_ S01PID09_LongFuelTrimBank2 m9 : 31|8@0+ (0.78125,-100) [-100|99.21875] "%" Vector__XXX
 SG_ S01PID0A_FuelPressure m10 : 31|8@0+ (3,0) [0|765] "kPa" Vector__XXX
 SG_ S01PID0B_IntakeManiAbsPress m11 : 31|8@0+ (1,0) [0|255] "kPa" Vector__XXX
 SG_ S01PID0C_EngineRPM m12 : 31|16@0+ (0.25,0) [0|16383.75] "rpm" Vector__XXX
 SG_ S01PID0D_VehicleSpeed m13 : 31|8@0+ (1,0) [0|255] "km/h" Vector__XXX
 SG_ S01PID0E_TimingAdvance m14 : 31|8@0+ (0.5,-64) [-64|63.5] "deg before TDC" Vector__XXX
 SG_ S01PID0F_IntakeAirTemperature m15 : 31|8@0+ (1,-40) [-40|215] "degC" Vector__XXX
 SG_ S01PID10_MAFAirFlowRate m16 : 31|16@0+ (0.01,0) [0|655.35] "grams/sec" Vector__XXX
 SG_ S01PID11_ThrottlePosition m17 : 31|8@0+ (0.39216,0) [0|100] "%" Vector__XXX
 SG_ S01PID12_CmdSecAirStatus m18 : 31|8@0+ (1,0) [0|255] "" Vector__XXX
 SG_ S01PID14_OxySensor1_STFT m20 : 39|8@0+ (0.78125,-100) [-100|99.21875] "%" Vector__XXX
 SG_ S01PID14_OxySensor1_Volt m20 : 31|8@0+ (0.005,0) [0|1.275] "volts" Vector__XXX
 SG_ S01PID15_OxySensor2_STFT m21 : 39|8@0+ (0.78125,-100) [-100|99.21875] "%" Vector__XXX
 SG_ S01PID15_OxySensor2_Volt m21 : 31|8@0+ (0.005,0) [0|1.275] "volts" Vector__XXX
 SG_ S01PID16_OxySensor3_STFT m22 : 39|8@0+ (0.78125,-100) [-100|99.21875] "%" Vector__XXX
 SG_ S01PID16_OxySensor3_Volt m22 : 31|8@0+ (0.005,0) [0|1.275] "volts" Vector__XXX
 SG_ S01PID17_OxySensor4_STFT m23 : 39|8@0+ (0.78125,-100) [-100|99.21875] "%" Vector__XXX
 SG_ S01PID17_OxySensor4_Volt m23 : 31|8@0+ (0.005,0) [0|1.275] "volts" Vector__XXX
 SG_ S01PID18_OxySensor5_STFT m24 : 39|8@0+ (0.78125,-100) [-100|99.21875] "%" Vector__XXX
 SG_ S01PID18_OxySensor5_Volt m24 : 31|8@0+ (0.005,0) [0|1.275] "volts" Vector__XXX
 SG_ S01PID19_OxySensor6_STFT m25 : 39|8@0+ (0.78125,-100) [-100|99.21875] "%" Vector__XXX
 SG_ S01PID19_OxySensor6_Volt m25 : 31|8@0+ (0.005,0) [0|1.275] "volts" Vector__XXX
 SG_ S01PID1A_OxySensor7_STFT m26 : 39|8@0+ (0.78125,-100) [-100|99.21875] "%" Vector__XXX
 SG_ S01PID1A_OxySensor7_Volt m26 : 31|8@0+ (0.005,0) [0|1.275] "volts" Vector__XXX
 SG_ S01PID1B_OxySensor8_STFT m27 : 39|8@0+ (0.78125,-100) [-100|99.21875] "%" Vector__XXX
 SG_ S01PID1B_OxySensor8_Volt m27 : 31|8@0+ (0.005,0) [0|1.275] "volts" Vector__XXX
 SG_ S01PID1C_OBDStandard m28 : 31|8@0+ (1,0) [0|255] "" Vector__XXX
 SG_ S01PID1F_TimeSinceEngStart m31 : 31|16@0+ (1,0) [0|65535] "seconds" Vector__XXX
 SG_ S01PID20_PIDsSupported_21_40 m32 : 31|32@0+ (1,0) [0|4294967295] "" Vector__XXX
 SG_ S01PID21_DistanceMILOn m33 : 31|16@0+ (1,0) [0|65535] "km" Vector__XXX
 SG_ S01PID22_FuelRailPres m34 : 31|16@0+ (0.079,0) [0|5177.265] "kPa" Vector__XXX
 SG_ S01PID23_FuelRailGaug m35 : 31|16@0+ (10,0) [0|655350] "kPa" Vector__XXX
 SG_ S01PID24_OxySensor1_FAER m36 : 31|16@0+ (3.0517578125E-05,0) [0|2] "ratio" Vector__XXX
 SG_ S01PID24_OxySensor1_Volt m36 : 47|16@0+ (0.0001220703125,0) [0|2] "volts" Vector__XXX
 SG_ S01PID25_OxySensor2_FAER m37 : 31|16@0+ (3.0517578125E-05,0) [0|2] "ratio" Vector__XXX
 SG_ S01PID25_OxySensor2_Volt m37 : 47|16@0+ (0.0001220703125,0) [0|8] "volts" Vector__XXX
 SG_ S01PID26_OxySensor3_FAER m38 : 31|16@0+ (3.0517578125E-05,0) [0|2] "ratio" Vector__XXX
 SG_ S01PID26_OxySensor3_Volt m38 : 47|16@0+ (0.0001220703125,0) [0|8] "volts" Vector__XXX
 SG_ S01PID27_OxySensor4_FAER m39 : 31|16@0+ (3.0517578125E-05,0) [0|2] "ratio" Vector__XXX
 SG_ S01PID27_OxySensor4_Volt m39 : 47|16@0+ (0.0001220703125,0) [0|8] "volts" Vector__XXX
 SG_ S01PID28_OxySensor5_FAER m40 : 31|16@0+ (3.0517578125E-05,0) [0|2] "ratio" Vector__XXX
 SG_ S01PID28_OxySensor5_Volt m40 : 47|16@0+ (0.0001220703125,0) [0|8] "volts" Vector__XXX
 SG_ S01PID29_OxySensor6_FAER m41 : 31|16@0+ (3.0517578125E-05,0) [0|2] "ratio" Vector__XXX
 SG_ S01PID29_OxySensor6_Volt m41 : 47|16@0+ (0.0001220703125,0) [0|8] "volts" Vector__XXX
 SG_ S01PID2A_OxySensor7_FAER m42 : 31|16@0+ (3.0517578125E-05,0) [0|2] "ratio" Vector__XXX
 SG_ S01PID2A_OxySensor7_Volt m42 : 47|16@0+ (0.0001220703125,0) [0|8] "volts" Vector__XXX
 SG_ S01PID2B_OxySensor8_FAER m43 : 31|16@0+ (3.0517578125E-05,0) [0|2] "ratio" Vector__XXX
 SG_ S01PID2B_OxySensor8_Volt m43 : 47|16@0+ (0.0001220703125,0) [0|8] "volts" Vector__XXX
 SG_ S01PID2C_CmdEGR m44 : 31|8@0+ (0.39215686275,0) [0|100] "%" Vector__XXX
 SG_ S01PID2D_EGRError m45 : 31|8@0+ (0.78125,-100) [-100|99.21875] "%" Vector__XXX
 SG_ S01PID2E_CmdEvapPurge m46 : 31|8@0+ (0.39215686275,0) [0|100] "%" Vector__XXX
 SG_ S01PID2F_FuelTankLevel m47 : 31|8@0+ (0.39215686275,0) [0|100] "%" Vector__XXX
 SG_ S01PID30_WarmUpsSinceCodeClear m48 : 31|8@0+ (1,0) [0|255] "count" Vector__XXX
 SG_ S01PID31_DistanceSinceCodeClear m49 : 31|16@0+ (1,0) [0|65535] "km" Vector__XXX
 SG_ S01PID32_EvapSysVaporPres m50 : 31|16@0+ (0.25,0) [-8192|8191.75] "Pa" Vector__XXX
 SG_ S01PID33_AbsBaroPres m51 : 31|8@0+ (1,0) [0|255] "kPa" Vector__XXX
 SG_ S01PID34_OxySensor1_Crnt m52 : 47|16@0+ (0.00390625,-128) [-128|128] "mA" Vector__XXX
 SG_ S01PID34_OxySensor1_FAER m52 : 31|16@0+ (3.0517578125E-05,0) [0|2] "ratio" Vector__XXX
 SG_ S01PID35_OxySensor2_Crnt m53 : 47|16@0+ (0.00390625,-128) [-128|128] "mA" Vector__XXX
 SG_ S01PID35_OxySensor2_FAER m53 : 31|16@0+ (3.0517578125E-05,0) [0|2] "ratio" Vector__XXX
 SG_ S01PID36_OxySensor3_Crnt m54 : 47|16@0+ (0.00390625,-128) [-128|128] "mA" Vector__XXX
 SG_ S01PID36_OxySensor3_FAER m54 : 31|16@0+ (3.0517578125E-05,0) [0|2] "ratio" Vector__XXX
 SG_ S01PID37_OxySensor4_Crnt m55 : 47|16@0+ (0.00390625,-128) [-128|128] "mA" Vector__XXX
 SG_ S01PID37_OxySensor4_FAER m55 : 31|16@0+ (3.0517578125E-05,0) [0|2] "ratio" Vector__XXX
 SG_ S01PID38_OxySensor5_Crnt m56 : 47|16@0+ (0.00390625,-128) [-128|128] "mA" Vector__XXX
 SG_ S01PID38_OxySensor5_FAER m56 : 31|16@0+ (3.0517578125E-05,0) [0|2] "ratio" Vector__XXX
 SG_ S01PID39_OxySensor6_Crnt m57 : 47|16@0+ (0.00390625,-128) [-128|128] "mA" Vector__XXX
 SG_ S01PID39_OxySensor6_FAER m57 : 31|16@0+ (3.0517578125E-05,0) [0|2] "ratio" Vector__XXX
 SG_ S01PID3A_OxySensor7_Crnt m58 : 47|16@0+ (0.00390625,-128) [-128|128] "mA" Vector__XXX
 SG_ S01PID3A_OxySensor7_FAER m58 : 31|16@0+ (3.0517578125E-05,0) [0|2] "ratio" Vector__XXX
 SG_ S01PID3B_OxySensor8_Crnt m59 : 47|16@0+ (0.00390625,-128) [-128|128] "mA" Vector__XXX
 SG_ S01PID3B_OxySensor8_FAER m59 : 31|16@0+ (3.0517578125E-05,0) [0|2] "ratio" Vector__XXX
 SG_ S01PID3C_CatTempBank1Sens1 m60 : 31|16@0+ (0.1,-40) [-40|6513.5] "degC" Vector__XXX
 SG_ S01PID3D_CatTempBank2Sens1 m61 : 31|16@0+ (0.1,-40) [-40|6513.5] "degC" Vector__XXX
 SG_ S01PID3E_CatTempBank1Sens2 m62 : 31|16@0+ (0.1,-40) [-40|6513.5] "degC" Vector__XXX
 SG_ S01PID3F_CatTempBank2Sens2 m63 : 31|16@0+ (0.1,-40) [-40|6513.5] "degC" Vector__XXX
 SG_ S01PID40_PIDsSupported_41_60 m64 : 31|32@0+ (1,0) [0|4294967295] "" Vector__XXX
 SG_ S01PID41_MonStatusDriveCycle m65 : 31|32@0+ (1,0) [0|4294967295] "" Vector__XXX
 SG_ S01PID42_ControlModuleVolt m66 : 31|16@0+ (0.001,0) [0|65.535] "V" Vector__XXX
 SG_ S01PID43_AbsLoadValue m67 : 31|16@0+ (0.39215686275,0) [0|25700] "%" Vector__XXX
 SG_ S01PID44_FuelAirCmdEquiv m68 : 31|16@0+ (3.0517578125E-05,0) [0|2] "ratio" Vector__XXX
 SG_ S01PID45_RelThrottlePos m69 : 31|8@0+ (0.39215686275,0) [0|100] "%" Vector__XXX
 SG_ S01PID46_AmbientAirTemp m70 : 31|8@0+ (1,-40) [-40|215] "degC" Vector__XXX
 SG_ S01PID47_AbsThrottlePosB m71 : 31|8@0+ (0.39215686275,0) [0|100] "%" Vector__XXX
 SG_ S01PID48_AbsThrottlePosC m72 : 31|8@0+ (0.39215686275,0) [0|100] "%" Vector__XXX
 SG_ S01PID49_AbsThrottlePosD m73 : 31|8@0+ (0.39215686275,0) [0|100] "%" Vector__XXX
 SG_ S01PID4A_AbsThrottlePosE m74 : 31|8@0+ (0.39215686275,0) [0|100] "%" Vector__XXX
 SG_ S01PID4B_AbsThrottlePosF m75 : 31|8@0+ (0.39215686275,0) [0|100] "%" Vector__XXX
 SG_ S01PID4C_CmdThrottleAct m76 : 31|8@0+ (0.39215686275,0) [0|100] "%" Vector__XXX
 SG_ S01PID4D_TimeRunMILOn m77 : 31|16@0+ (1,0) [0|65535] "minutes" Vector__XXX
 SG_ S01PID4E_TimeSinceCodeClear m78 : 31|16@0+ (1,0) [0|65535] "minutes" Vector__XXX
 SG_ S01PID4F_Max_FAER m79 : 31|8@0+ (1,0) [0|255] "ratio" Vector__XXX
 SG_ S01PID4F_Max_IntManiAbsPres m79 : 55|8@0+ (10,0) [0|2550] "kPa" Vector__XXX
 SG_ S01PID4F_Max_OxySensCrnt m79 : 47|8@0+ (1,0) [0|255] "mA" Vector__XXX
 SG_ S01PID4F_Max_OxySensVol m79 : 39|8@0+ (1,0) [0|255] "V" Vector__XXX
 SG_ S01PID50_Max_AirFlowMAF m80 : 31|8@0+ (10,0) [0|2550] "g/s" Vector__XXX
 SG_ S01PID51_FuelType m81 : 31|8@0+ (1,0) [0|255] "" Vector__XXX
 SG_ S01PID52_EthanolFuelPct m82 : 31|8@0+ (0.39215686275,0) [0|100] "%" Vector__XXX
 SG_ S01PID53_AbsEvapSysVapPres m83 : 31|16@0+ (0.005,0) [0|327.675] "kPa" Vector__XXX
 SG_ S01PID54_EvapSysVapPres m84 : 31|16@0+ (1,-32767) [-32767|32768] "Pa" Vector__XXX
 SG_ S01PID55_ShortSecOxyTrimBank1 m85 : 31|8@0+ (0.78125,-100) [-100|99.21875] "%" Vector__XXX
 SG_ S01PID55_ShortSecOxyTrimBank3 m85 : 39|8@0+ (0.78125,-100) [-100|99.21875] "%" Vector__XXX
 SG_ S01PID56_LongSecOxyTrimBank1 m86 : 31|8@0+ (0.78125,-100) [-100|99.21875] "%" Vector__XXX
 SG_ S01PID56_LongSecOxyTrimBank3 m86 : 39|8@0+ (0.78125,-100) [-100|99.21875] "%" Vector__XXX
 SG_ S01PID57_ShortSecOxyTrimBank2 m87 : 31|8@0+ (0.78125,-100) [-100|99.21875] "%" Vector__XXX
 SG_ S01PID57_ShortSecOxyTrimBank4 m87 : 39|8@0+ (0.78125,-100) [-100|99.21875] "%" Vector__XXX
 SG_ S01PID58_LongSecOxyTrimBank2 m88 : 31|8@0+ (0.78125,-100) [-100|99.21875] "%" Vector__XXX
 SG_ S01PID58_LongSecOxyTrimBank4 m88 : 39|8@0+ (0.78125,-100) [-100|99.21875] "%" Vector__XXX
 SG_ S01PID59_FuelRailAbsPres m89 : 31|16@0+ (10,0) [0|655350] "kPa" Vector__XXX
 SG_ S01PID5A_RelAccelPedalPos m90 : 31|8@0+ (0.39215686275,0) [0|100] "%" Vector__XXX
 SG_ S01PID5B_HybrBatPackRemLife m91 : 31|8@0+ (0.39215686275,0) [0|100] "%" Vector__XXX
 SG_ S01PID5C_EngineOilTemp m92 : 31|8@0+ (1,-40) [-40|215] "degC" Vector__XXX
 SG_ S01PID5D_FuelInjectionTiming m93 : 31|16@0+ (0.0078125,-210) [-210|301.9921875] "deg" Vector__XXX
 SG_ S01PID5E_EngineFuelRate m94 : 31|16@0+ (0.05,0) [0|3276.75] "L/h" Vector__XXX
 SG_ S01PID5F_EmissionReq m95 : 31|8@0+ (1,0) [0|255] "" Vector__XXX
 SG_ S01PID60_PIDsSupported_61_80 m96 : 31|32@0+ (1,0) [0|4294967295] "" Vector__XXX
 SG_ S01PID61_DemandEngTorqPct m97 : 31|8@0+ (1,-125) [-125|130] "%" Vector__XXX
 SG_ S01PID62_ActualEngTorqPct m98 : 31|8@0+ (1,-125) [-125|130] "%" Vector__XXX
 SG_ S01PID63_EngRefTorq m99 : 31|16@0+ (1,0) [0|65535] "Nm" Vector__XXX
 SG_ S01PID65_AuxInputOutput m101 : 31|8@0+ (1,0) [0|255] "" Vector__XXX
 SG_ S01PID66_MAFSensor m102 : 31|8@0+ (1,0) [0|255] "" Vector__XXX
 SG_ S01PID67_EngineCoolantTemp m103 : 31|8@0+ (1,0) [0|255] "" Vector__XXX
 SG_ S01PID68_IntakeAirTempSens m104 : 31|8@0+ (1,0) [0|255] "" Vector__XXX
 SG_ S01PID69_CmdEGR_EGRError m105 : 31|8@0+ (1,0) [0|255] "" Vector__XXX
 SG_ S01PID6A_CmdDieselIntAir m106 : 31|8@0+ (1,0) [0|255] "" Vector__XXX
 SG_ S01PID6B_ExhaustGasTemp m107 : 31|8@0+ (1,0) [0|255] "" Vector__XXX
 SG_ S01PID6C_CmdThrottleActRel m108 : 31|8@0+ (1,0) [0|255] "" Vector__XXX
 SG_ S01PID6D_FuelPresContrSys m109 : 31|8@0+ (1,0) [0|255] "" Vector__XXX
 SG_ S01PID6E_InjPresContrSys m110 : 31|8@0+ (1,0) [0|255] "" Vector__XXX
 SG_ S01PID6F_TurboComprPres m111 : 31|8@0+ (1,0) [0|255] "" Vector__XXX
 SG_ S01PID70_BoostPresCntrl m112 : 31|8@0+ (1,0) [0|255] "" Vector__XXX
 SG_ S01PID80_PIDsSupported_81_A0 m128 : 31|32@0+ (1,0) [0|4294967295] "" Vector__XXX
 SG_ S01PID8E_EngFrictionPctTorq m142 : 31|8@0+ (1,-125) [-125|130] "%" Vector__XXX
 SG_ S01PIDA0_PIDsSupported_A1_C0 m160 : 31|32@0+ (1,0) [0|4294967295] "" Vector__XXX
 SG_ S01PIDA6_Odometer m166 : 31|32@0+ (0.1,0) [0|429496729.5] "km" Vector__XXX
 SG_ S01PIDC0_PIDsSupported_C1_E0 m192 : 31|32@0+ (1,0) [0|4294967295] "" Vector__XXX
